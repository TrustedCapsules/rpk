## drivers/tee/Kconfig
```kconfig
# Generic Trusted Execution Environment Configuration
config TEE
	tristate "Trusted Execution Environment support"
	select DMA_SHARED_BUFFER
	select GENERIC_ALLOCATOR
	help
	  This implements a generic interface towards a Trusted Execution
	  Environment (TEE).

config BREAKDOWN
    bool "OPTEE Breakdown config"
    help
        Enables the breakdown code in the OPTEE and interceptor modules

if TEE

menu "TEE drivers"

source "drivers/tee/optee/Kconfig"
source "drivers/tee/interceptor/Kconfig"

endmenu

endif
```

## drivers/tee/interceptor/Kconfig
```kconfig
# Trusted Capsules Interceptor Configuration
config INTERCEPTOR
    tristate "Trusted Capsules Interceptor"
    depends on OPTEE
    help
        This enables the interceptor for trusted capsules.
```
